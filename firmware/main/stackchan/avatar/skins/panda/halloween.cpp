/*
 * SPDX-License-Identifier: MIT
 */
#include "panda.h"
#include "../../../utils/random.h"
#include <hal/utils/sd_images.h>
#include <hal/hal.h>
#include <atomic>
#include <cmath>

using namespace uitk;
using namespace uitk::lvgl_cpp;
using namespace stackchan;
using namespace stackchan::avatar;

// Images live on the SD card (imagens/halloween/), generated by assets_src/halloween/build_assets.py
static const lv_image_dsc_t* image(const char* name)
{
    return sd_images::get((std::string("halloween/") + name).c_str());
}

static const lv_color_t _patch_color  = lv_color_hex(0x141018);
static const lv_color_t _orange_color = lv_color_hex(0xFF8A00);
static const lv_color_t _thread_color = lv_color_hex(0xD9CCF0);

static const uint32_t _flap_interval_ms   = 160;
static const uint32_t _bob_period_ms      = 2400;
static const int _bob_amplitude           = 2;
static const int _flicker_chance          = 150;  // 1 in N updates
static const int _spider_x                = 14;
static const int _spider_mid_y            = 84;
static const int _spider_amplitude        = 18;
static const uint32_t _spider_period_ms   = 6000;

static std::atomic<bool> _scenery_paused{false};
static std::atomic<bool> _scenery_frozen{false};

void stackchan::avatar::setSceneryPaused(bool paused)
{
    _scenery_paused.store(paused);
}

void stackchan::avatar::setSceneryFrozen(bool frozen)
{
    _scenery_frozen.store(frozen);
}

static float wave(uint32_t now, uint32_t periodMs, uint32_t phaseMs = 0)
{
    return std::sin(2.0f * (float)M_PI * (float)((now + phaseMs) % periodMs) / (float)periodMs);
}

void HalloweenPandaAvatar::init(lv_obj_t* parent, const lv_font_t* font)
{
    _pannel = std::make_unique<Container>(parent);
    _pannel->align(LV_ALIGN_CENTER, 0, 0);
    _pannel->setSize(320, 240);
    _pannel->setRadius(0);
    _pannel->setBorderWidth(0);
    _pannel->setPadding(0, 0, 0, 0);
    _pannel->setBgColor(_patch_color);
    _pannel->removeFlag(LV_OBJ_FLAG_SCROLLABLE);

    // Without the card the sky stays plain; the face still works
    _pannel->setBgColor(lv_color_hex(0x241238));
    _background = std::make_unique<Image>(_pannel->get());
    _background->setSrc(image("halloween_bg"));
    _background->setAlign(LV_ALIGN_TOP_LEFT);
    _background->setPos(0, 0);

    // Scenery goes under the face elements
    addDecorator(std::make_unique<HalloweenSceneryDecorator>(_pannel->get()));

    // Orange eyes with an eyelid in the patch color, so blinking blends into the patch
    _key_elements.leftEye      = std::make_unique<DefaultEyes>(_pannel->get(), _orange_color, _patch_color, true);
    _key_elements.rightEye     = std::make_unique<DefaultEyes>(_pannel->get(), _orange_color, _patch_color, false);
    _key_elements.mouth        = std::make_unique<PandaMouth>(_pannel->get(), _patch_color, image("halloween_fang"));

    // No speech bubble: the kids using it can't read yet, and it saves RAM. setSpeech() is a no-op without it
    (void)font;
}

Container* HalloweenPandaAvatar::getPanel() const
{
    if (_pannel) {
        return _pannel.get();
    }
    return NULL;
}

HalloweenSceneryDecorator::HalloweenSceneryDecorator(lv_obj_t* parent)
{
    // Bats fly figure-eights around the sky: {center, radius, period, phase}
    const struct {
        Vector2i center;
        Vector2i radius;
        uint32_t periodMs;
        uint32_t phaseMs;
    } bat_paths[3] = {
        {Vector2i(250, 24), Vector2i(26, 7), 7000, 0},
        {Vector2i(296, 82), Vector2i(10, 14), 5200, 1700},
        {Vector2i(106, 20), Vector2i(22, 6), 6100, 3100},
    };
    for (int i = 0; i < 3; i++) {
        auto& bat    = _bats[i];
        bat.image    = std::make_unique<Image>(parent);
        bat.image->setSrc(image("halloween_bat_up"));
        bat.image->setAlign(LV_ALIGN_TOP_LEFT);
        bat.center   = bat_paths[i].center;
        bat.radius   = bat_paths[i].radius;
        bat.periodMs = bat_paths[i].periodMs;
        bat.phaseMs  = bat_paths[i].phaseMs;
        bat.wingsUp  = (i % 2) == 0;
    }

    // Spider hanging from the cobweb
    _thread = std::make_unique<Container>(parent);
    _thread->setAlign(LV_ALIGN_TOP_LEFT);
    _thread->setRadius(0);
    _thread->setBorderWidth(0);
    _thread->setBgColor(_thread_color);
    _thread->setBgOpa(LV_OPA_70);
    _thread->removeFlag(LV_OBJ_FLAG_SCROLLABLE);
    _thread->removeFlag(LV_OBJ_FLAG_CLICKABLE);
    _thread->setPos(_spider_x, 0);
    _thread->setSize(1, _spider_mid_y);

    _spider = std::make_unique<Image>(parent);
    _spider->setSrc(image("halloween_spider"));
    _spider->setAlign(LV_ALIGN_TOP_LEFT);

    // Pumpkins in the bottom corners: {lit, unlit, top-left position, bob phase}
    _pumpkins[0] = {nullptr, image("halloween_pumpkin_big_on"), image("halloween_pumpkin_big_off"), Vector2i(3, 178), 0, 0, true};
    _pumpkins[1] = {nullptr, image("halloween_pumpkin_small_on"), image("halloween_pumpkin_small_off"), Vector2i(268, 196), 1200, 0,
                    true};
    for (auto& pumpkin : _pumpkins) {
        pumpkin.image = std::make_unique<Image>(parent);
        pumpkin.image->setSrc(pumpkin.lit);
        pumpkin.image->setAlign(LV_ALIGN_TOP_LEFT);
        pumpkin.image->setPos(pumpkin.pos.x, pumpkin.pos.y);
    }

    _update();
}

HalloweenSceneryDecorator::~HalloweenSceneryDecorator()
{
}

void HalloweenSceneryDecorator::_update()
{
    uint32_t now = GetHAL().millis();

    // Frozen while napping, with the candles out
    if (_scenery_paused.load()) {
        if (!_paused) {
            _paused = true;
            for (auto& pumpkin : _pumpkins) {
                pumpkin.isLit = false;
                pumpkin.image->setSrc(pumpkin.unlit);
            }
        }
        return;
    }
    _paused = false;

    if (_scenery_frozen.load()) {
        return;
    }

    // Bats
    bool flap = now >= _next_flap_tick;
    if (flap) {
        _next_flap_tick = now + _flap_interval_ms;
    }
    for (auto& bat : _bats) {
        float x = bat.radius.x * wave(now, bat.periodMs, bat.phaseMs);
        float y = bat.radius.y * wave(now, bat.periodMs / 2, bat.phaseMs);
        bat.image->setPos(bat.center.x + (int)x - 18, bat.center.y + (int)y - 11);
        if (flap) {
            bat.wingsUp = !bat.wingsUp;
            bat.image->setSrc(bat.wingsUp ? image("halloween_bat_up") : image("halloween_bat_down"));
        }
    }

    // Pumpkins bob and their candles flicker now and then
    auto& random = Random::getInstance();
    for (auto& pumpkin : _pumpkins) {
        int bob = (int)std::lround(_bob_amplitude * wave(now, _bob_period_ms, pumpkin.phaseMs));
        pumpkin.image->setPos(pumpkin.pos.x, pumpkin.pos.y + bob);

        bool should_be_lit = now >= pumpkin.unlitUntil;
        if (should_be_lit && random.getInt(0, _flicker_chance) == 0) {
            pumpkin.unlitUntil = now + random.getInt(120, 400);
            should_be_lit      = false;
        }
        if (should_be_lit != pumpkin.isLit) {
            pumpkin.isLit = should_be_lit;
            pumpkin.image->setSrc(should_be_lit ? pumpkin.lit : pumpkin.unlit);
        }
    }

    // Spider goes up and down its thread
    int spider_y = _spider_mid_y + (int)(_spider_amplitude * wave(now, _spider_period_ms));
    _thread->setSize(1, spider_y - 8);
    _spider->setPos(_spider_x - 11, spider_y - 10);
}
